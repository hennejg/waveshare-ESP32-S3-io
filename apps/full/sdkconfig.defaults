## components/board/Kconfig
```kconfig
menu "Board driver options"

config APP_MQTT_ENABLE
    bool "Enable MQTT integration in board drivers"
    default y
    help
        When enabled, DI/DO/LED/buzzer drivers publish and subscribe over MQTT.
        Disable for firmwares without an MQTT broker (e.g. Matter-only builds).

config APP_SNTP_ENABLE
    bool "Enable SNTP time synchronisation"
    default y
    help
        Periodically sync the system clock from an NTP server and mirror each
        sync to the battery-backed RTC.  Disable for firmwares that do not need
        accurate local time (e.g. Matter-only builds).

config APP_AUX_DI_ENABLE
    bool "Offer GPIO1, GPIO44 and GPIO43 as NON-ISOLATED inputs, PWM and analog"
    depends on !APP_MATTER_ENABLE
    default y
    help
        Lets each of the three header pins IO1, RXD and TXD (GPIO1, GPIO44,
        GPIO43) be switched, per pin, in the web UI (Device tab) or with "aux"
        in /api/config: standard function, digital input, or PWM output with
        its own frequency (5 Hz .. 1 MHz) and duty cycle; GPIO1 also as analog
        input (ADC1 channel 0, 0..3.1 V).  The change takes effect on saving;
        no reboot.  Every pin starts in its standard function.  One thing does
        change with the option on: the input table in NVS has eleven entries,
        which an eight-input firmware (older releases, Matter) cannot read
        back -- going back loses the input names (README).

        Standard function: GPIO1 is high-impedance (this firmware does not use
        it); GPIO44 and GPIO43 are UART0 RX and TX, which is where the console is.
        In any other mode the pin is taken off UART0 -- the console keeps
        running on USB-Serial/JTAG, and on UART0 it simply no longer reaches
        the pin.

        The channels are AUX1, AUX2 and AUX3, channels 8..10 of the DI array
        behind the eight isolated ones.  A channel in its standard function
        reads false and is not published.

        These three pins run straight to the ESP32-S3: no optocoupler, no
        series resistor, no reverse protection.  They need external protection
        and must never see more than 3.3 V or less than 0 V.

        GPIO43 (TXD) is U0TXD.  The console stays on UART0, so the ROM
        bootloader, the second-stage bootloader and the early application log
        drive it as a push-pull output from every reset until the pads are set
        up -- and indefinitely in UART download mode (esptool, BOOT button).
        As an input it needs a series resistor of at least 1 kOhm; as a PWM
        output its load sees that traffic at every reset.  GPIO43 is
        deliberately the LAST channel, so a board that needs only two extra
        inputs can leave it unwired.  GPIO44 (RXD) is an input at reset;
        GPIO1 is unused by this firmware.

        A PWM output is under control only while the firmware runs: switching
        a PWM pad to another mode pulls it high (input pull-up, UART idle
        level), so a load is switched off with duty 0, and a driver input
        wants an external pull-down for the time before the pads are set up.

        Inputs, PWM and the analog reading are available over the web UI, the
        REST API, MQTT (aux/...), Modbus (discrete inputs 10009-10011, holding
        registers 40003-40011, input registers 30101-30104) and the rule
        engine (input(8..10), pwm(), analog()).  Not over CAN, which packs the
        input states into a single byte.

        Not offered in a Matter build.  The Matter app exposes exactly eight
        Contact Sensor endpoints and its own web UI builds eight input rows, so
        the extra channels would be invisible there — better unavailable than
        half working.

config APP_SCRIPTING_ENABLE
    bool "Enable scripting engine callbacks"
    default n
    help
        Internal: set by the full firmware when the rule engine is present.
        Enables scripting_on_time_sync() call in sntp_sync.c.

endmenu
```

## components/modbus/Kconfig
```kconfig
menu "Modbus (board)"

config MB_RS485_MASTER
    bool "RS-485 master"
    default y
    help
        Lets the board drive the RS-485 segment as its Modbus master, for the
        RS-485 rows of the poll table and, with MB_GATEWAY, for the Modbus
        TCP gateway. Without it the board is only ever an RTU slave on
        RS-485; a configuration that says "master" (stored by the other
        firmware) runs as slave.

config MB_GATEWAY
    bool "Modbus TCP to RS-485 gateway"
    depends on MB_RS485_MASTER
    default y
    help
        Forwards Modbus TCP requests for other unit IDs to the devices on the
        RS-485 segment. Without it a stored "gateway" setting is ignored and
        the master serves the poll table only.

config MB_TCP_MASTER
    bool "Poll table rows on the network (Modbus TCP master)"
    default y
    help
        Lets the poll table read devices over Modbus TCP as well as on
        RS-485. Without it network rows are refused and only RS-485 rows are
        read.

config MB_TCP_MASTER_CONNS
    int "Connections kept open to polled network devices"
    depends on MB_TCP_MASTER
    range 1 8
    default 3
    help
        Sockets the poll table keeps open between polls; the application's
        net_budget.h adds them up against CONFIG_LWIP_MAX_SOCKETS.

config MB_TCP_MAX_CONN
    int "Modbus TCP clients served at once"
    range 1 16
    default 8
    help
        Connections the Modbus TCP server (port 502) keeps open at the same
        time. Each holds an lwIP socket; the application's net_budget.h adds
        them up against CONFIG_LWIP_MAX_SOCKETS. A client arriving with every
        slot taken is accepted and closed at once.

config MB_TCP_BACKLOG
    int "Modbus TCP listen backlog"
    range 1 32
    default 16
    help
        Connections lwIP may complete before the server accepts them. They
        hold a TCP PCB each, not a socket.

endmenu
```

## components/scripting/Kconfig
```kconfig
menu "Rule engine"

    config SCRIPTING_TIME_BUDGET_MS
        int "Time budget per rule-engine event (ms, 0 = unlimited)"
        default 2000
        range 0 60000
        help
            Upper bound on how long one event may spend inside JavaScript —
            an input edge, an MQTT message, a timer, or loading a script.

            Without a bound, a user script containing an endless loop stops the
            rule engine for good: every later event, including the reload of a
            corrected script, queues up behind it and is never processed. The
            HTTP handler still answers ok, and the task watchdog only prints a
            message because CONFIG_ESP_TASK_WDT_PANIC is not set. Since the
            script is written to NVS before it ever runs, rebooting re-enters
            the same hang.

            When the budget is exceeded, QuickJS throws InternalError at the
            next interrupt check. It cannot be caught: the rule that ran over
            is cut short, and the engine goes on with the rules after it on
            the same event, each try with a fresh budget -- up to three more
            rules that run over per event, after which the rest of that event
            is dropped. A heldFor() check cut short is tried again after
            another held period. One event can therefore hold the engine for
            up to five budgets.

            2000 ms is generous for I/O automation, where a rule body is
            normally a handful of operations. Raise it if you do heavy work in
            a rule; 0 disables the check and restores the old behaviour.

endmenu
```
