## apps/matter/main/Kconfig.projbuild
```kconfig
menu "Application"

config APP_MATTER_ENABLE
    bool "Enable Matter protocol support"
    default y
    select BT_ENABLED
    select BT_NIMBLE_ENABLED
    help
        Enable the Matter (formerly CHIP) protocol stack.
        Provides 8 On/Off Plug-In Unit endpoints (digital outputs) and
        8 Contact Sensor endpoints (digital inputs) for home-automation
        controllers like Apple Home, Google Home, and Home Assistant.

        When enabled, the device advertises via BLE for commissioning and
        via mDNS (_matter._tcp) once commissioned. Commissioning state and
        fabric credentials are stored in the "fctry" NVS partition.

        Adds roughly 1.5 MB to flash usage and ~200 KB to RAM usage.

endmenu
```

## sdkconfig.defaults
```kconfig
# Target: ESP32-S3 (set via: idf.py set-target esp32s3)
# Waveshare ESP32-S3-POE-ETH-8DI-8DO: 16MB flash, 8MB OCTAL PSRAM

CONFIG_ESPTOOLPY_FLASHSIZE_16MB=y
CONFIG_ESPTOOLPY_FLASHSIZE="16MB"

# Enable PSRAM (8MB OPI/OCTAL on this board)
CONFIG_ESP32S3_SPIRAM_SUPPORT=y
CONFIG_SPIRAM_MODE_OCT=y
CONFIG_SPIRAM_SPEED_80M=y

# Partition table: use custom to fit 16MB flash
CONFIG_PARTITION_TABLE_CUSTOM=y
CONFIG_PARTITION_TABLE_CUSTOM_FILENAME="partitions.csv"

# WiFi
CONFIG_ESP_WIFI_SOFTAP_SUPPORT=y
# Reduce WiFi static TX buffer count from 16 (default) to 8.  Each static TX
# buffer is ~1600 B allocated from DIRAM (MALLOC_CAP_INTERNAL|MALLOC_CAP_DMA).
# BLE controller falls back to the 32 KB DMA pool for its 4 KiB EMI region
# (the DMA pool is untouched by WiFi TX buffers).
# 6 buffers caused SoftAP auth frame drops (wifi:m f auth) under concurrent BLE.
# 10 buffers exhausted the pvPortMalloc (INTERNAL-only) budget during NimBLE
# host init, crashing at ble_gap_init() mutex creation.  8 is the compromise:
# enough TX capacity to avoid auth drops, enough DRAM headroom for NimBLE —
# especially when combined with CONFIG_BT_NIMBLE_MEM_ALLOC_MODE_EXTERNAL=y.
# (Dynamic TX buffers are Kconfig-forbidden when SPIRAM_TRY_ALLOCATE_WIFI_LWIP=y)
CONFIG_ESP_WIFI_STATIC_TX_BUFFER_NUM=8
# With Matter+BLE active, internal DMA is extremely scarce (~25 KB after
# matter_init).  WiFi static RX buffers (1600 B each, MALLOC_CAP_DMA|INTERNAL)
# are the largest tunable consumer; 2 is the minimum and sufficient for the
# typical MQTT/HTTP workload.  32 dynamic RX buffers handle burst receive.
CONFIG_ESP_WIFI_STATIC_RX_BUFFER_NUM=2

# Ethernet — enable built-in SPI Ethernet and W5500 driver
CONFIG_ETH_USE_SPI_ETHERNET=y
CONFIG_ETH_SPI_ETHERNET_W5500=y

# Logging
CONFIG_LOG_DEFAULT_LEVEL_INFO=y

# Disable mbedTLS hardware acceleration to avoid GDMA conflicts with I2C.
# RSA DS peripheral key only exists in IDF v6+, omitted here.
CONFIG_MBEDTLS_HARDWARE_SHA=n
CONFIG_MBEDTLS_HARDWARE_AES=n
CONFIG_MBEDTLS_HARDWARE_MPI=n

# --- Matter / esp-matter ---
# HKDF is required by the CHIP crypto PAL
CONFIG_MBEDTLS_HKDF_C=y

# BLE stack kept for Matter stack compatibility; advertising is disabled at
# runtime so the device uses mDNS/OnNetwork commissioning. This avoids the
# WiFi/BLE coexistence problem that stalls TCP connections on the HTTP server.
CONFIG_BT_ENABLED=y
CONFIG_BT_NIMBLE_ENABLED=y
CONFIG_BT_NIMBLE_ENABLE_CONN_REATTEMPT=n

# TCP send/receive buffers — default 5760 bytes is too small to serve static
# files without EAGAIN when the WiFi radio is intermittently busy.
CONFIG_LWIP_TCP_SND_BUF_DEFAULT=16384
CONFIG_LWIP_TCP_WND_DEFAULT=16384

# IPv6 — Matter needs link-local + per-fabric ULAs
CONFIG_LWIP_IPV6_AUTOCONFIG=y
CONFIG_LWIP_IPV6_NUM_ADDRESSES=6
CONFIG_LWIP_HOOK_IP6_ROUTE_DEFAULT=y
CONFIG_LWIP_HOOK_ND6_GET_GW_DEFAULT=y

# 8 DO + 8 DI + root endpoint = 17; add margin
CONFIG_ESP_MATTER_MAX_DYNAMIC_ENDPOINT_COUNT=20

# Stack sizes — reduced to reclaim internal DMA for Matter+BLE+Ethernet.
# app_main only needs 6 KB; matter_init runs synchronously but CHIP task is
# separate.  CHIP task needs 8 KB: 6 KB was not enough for the ECDSA P-256
# attestation signing during commissioning (AttestationRequest triggers a
# ~3–4 KB mbedTLS stack burst that overflowed the 6 KB stack).
# NimBLE host task 5 KB sufficient (pool buffers go to PSRAM via
# NIMBLE_MEM_ALLOC_MODE_EXTERNAL).
CONFIG_ESP_MAIN_TASK_STACK_SIZE=6144
CONFIG_CHIP_TASK_STACK_SIZE=8192
CONFIG_BT_NIMBLE_TASK_STACK_SIZE=5120
# NimBLE host pool buffers (event queues, callouts, mutexes, semaphores) go to
# PSRAM with EXTERNAL mode, freeing ~5-10 KiB of internal DRAM for FreeRTOS
# Queue_t / Timer_t objects (pvPortMalloc = INTERNAL-only, no PSRAM fallback).
# With SPIRAM_TRY_ALLOCATE_WIFI_LWIP=y the INTERNAL budget is tight; EXTERNAL
# mode is what gives 8 WiFi TX buffers enough headroom to coexist with BLE.
# BLE controller uses bt_osi_mem_calloc_internal which ignores this setting.
# BLE controller activity slots.  Each slot consumes 828 bytes of BLE
# controller IRAM/DRAM (separate from the application heap).  The Kconfig
# default is 6; it was inadvertently set to 2 in sdkconfig, which starved
# the controller: BLE connection handling failed with BLE_INIT: Malloc
# failed, and LE Set Advertising Data returned BLE_ERR_MEM_CAPACITY after
# every disconnect.  Explicitly lock to the correct default.
CONFIG_BT_CTRL_BLE_MAX_ACT=6
# With STATIC=0 (the default), the BLE controller allocates ACL TX buffers
# dynamically from the internal DMA heap at connection time.  By that point,
# the heap is severely fragmented (~7.7 KB largest free block), so even modest
# allocations fail with "BLE_INIT: Malloc failed" 90 ms after BLE connect,
# preventing the CHIP PASE session from making progress and timing out at 22 s.
# Setting this to 6 pre-allocates the pool during controller init (when
# DMA_largest is still ~31 KB), eliminating all connection-time heap allocation
# in the BLE controller and the consequent post-disconnect BLE_ERR_MEM_CAPACITY
# on ble_gap_adv_set_data.
CONFIG_BT_CTRL_BLE_STATIC_ACL_TX_BUF_NB=6

CONFIG_BT_NIMBLE_MEM_ALLOC_MODE_EXTERNAL=y

# mbedTLS BIGNUM/ECC workspace exhausts internal DRAM during NOC chain
# verification (AddNOC step of Matter commissioning).  DEFAULT mode falls
# back to PSRAM when internal DRAM is exhausted.  BIGNUM/ECC operations are
# pure CPU — no DMA — so PSRAM is safe here.
CONFIG_MBEDTLS_DEFAULT_MEM_ALLOC=y

# PSRAM heap routing — allocations > 1024 B go to PSRAM via malloc().
# The W5500 rx_buffer uses heap_caps_malloc(MALLOC_CAP_DMA) and therefore
# always lands in internal SRAM regardless of this threshold.
# With ALWAYSINTERNAL=1024 the CHIP/NimBLE session objects (1025-4095 B range)
# go to PSRAM, preserving ~8 KB more of internal DRAM headroom compared to
# ALWAYSINTERNAL=4096.  The previous bounce-buffer fragmentation problem (SPI
# RX path allocating 64-byte heap blocks on every W5500 transaction) is now
# fixed in the W5500 MAC driver: the static DMA buffer is 64-byte aligned and
# read lengths are padded to 64-byte multiples, so setup_dma_priv_buffer never
# allocates a bounce buffer from the heap.
CONFIG_SPIRAM_MALLOC_ALWAYSINTERNAL=1024
# Move application .bss to PSRAM (~14 KB freed, measured on boot).  Safe for
# non-DMA-critical static data; DMA drivers are unaffected.
CONFIG_SPIRAM_ALLOW_BSS_SEG_EXTERNAL_MEMORY=y
# Allow FreeRTOS tasks (httpd, mqtt, etc.) to allocate their stacks in PSRAM
# when internal DRAM is exhausted.
CONFIG_SPIRAM_ALLOW_STACK_EXTERNAL_MEMORY=y
# Move WiFi static RX buffers (~16 KB) and the lwIP pbuf pool to PSRAM.
# Without this, those pools sit in internal DRAM and fragment it so severely
# that the W5500 SPI driver can no longer allocate its ~1500-byte DMA bounce
# buffers (MALLOC_CAP_INTERNAL|DMA) — causing continuous TX errors under load.
CONFIG_SPIRAM_TRY_ALLOCATE_WIFI_LWIP=y

# The on_wifi_ready callback runs in the FreeRTOS timer service task
# (wifi-bootstrap fires it from a TimerHandle_t callback).  The default
# 2048 bytes is far too small: httpd_start() + ESP_LOGE overflow it.
CONFIG_FREERTOS_TIMER_TASK_STACK_DEPTH=8192

# httpd stack (> SPIRAM_MALLOC_ALWAYSINTERNAL=4096) lands in PSRAM.
CONFIG_HTTPD_STACK_SIZE=6144

# OTA requestor (needed by esp_matter_ota_provider component)
CONFIG_ENABLE_OTA_REQUESTOR=y

# Enable Ethernet NetworkCommissioning driver so the device can commission via
# Ethernet when a cable is connected (no WiFi credential step).  The default
# ESPEthernetDriver::Init() is overridden in the submodule to use the existing
# W5500 netif (ETH_DEF) instead of trying to set up a built-in EMAC.
# ENABLE_ETHERNET_TELEMETRY is the Kconfig gate for ETHERNET_NETWORK_COMMISSIONING_DRIVER.
CONFIG_ENABLE_ETHERNET_TELEMETRY=y
CONFIG_ETHERNET_NETWORK_COMMISSIONING_DRIVER=y
CONFIG_ETHERNET_NETWORK_ENDPOINT_ID=0

# Matter device identification strings (VendorID 0xFFF1 is the CSA test VID)
CONFIG_CHIP_PROJECT_CONFIG="main/CHIPProjectConfig.h"

# Prevent WiFi mode from persisting to NVS.  Without this, a captive-portal
# session sets WIFI_MODE_APSTA via esp_wifi_set_mode(), which is restored from
# NVS on the next boot by StartWiFiLayer() → esp_wifi_start() before BLE is
# released.  The 752-byte SoftAP beacon buffer cannot be allocated from DMA
# heap while BLE is active, causing a LoadProhibited crash in
# ieee80211_hostap_attach.  Matter stores credentials in its own chip-* NVS
# namespace and does not rely on WiFi NVS.
CONFIG_ESP_WIFI_NVS_ENABLED=n
```
